## br2_bd_guillaume/package/test_influxdb/Config.in
```kconfig
config BR2_PACKAGE_INFLUXDB
    bool "influxdb"
    help
        InfluxDB is a time-series database built from the ground up to 
        handle high write and query loads.
```

## br2_bd_guillaume/packages/golang/Config.in
```kconfig
config BR2_PACKAGE_GOLANG
    bool "golang"
    help
        Go is an open source programming language that makes it easy to build simple, reliable, and efficient software.
```

## stt_env/Config.in
```kconfig
menu "Custom packages"
source "$BR2_EXTERNAL_STT_ENV_PATH/package/stt_ihm/Config.in"
source "$BR2_EXTERNAL_STT_ENV_PATH/package/influxdb_golang_test/Config.in"
endmenu
```
